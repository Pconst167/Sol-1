#include <stdio.h>

#define WIDTH  60
#define HEIGHT 50


// Global arrays to hold the current and next states of the game grid
char nextState[HEIGHT][WIDTH];
char currState[HEIGHT][WIDTH] = {
' ',' ',' ',' ',' ',' ',' ',' ',' ',' ',' ',' ',' ',' ',' ',' ',' ',' ',' ',' ',' ',' ',' ',' ',' ',' ',' ',' ',' ',' ',' ',' ',' ',' ',' ',' ',' ',' ',' ',' ',
' ',' ',' ',' ',' ',' ',' ',' ',' ',' ',' ',' ',' ',' ',' ',' ',' ',' ',' ',' ',' ',' ',' ',' ',' ',' ',' ',' ',' ',' ',' ',' ',' ',' ',' ',' ',' ',' ',' ',' ',
' ',' ',' ',' ',' ',' ',' ',' ',' ',' ',' ',' ',' ',' ',' ',' ',' ',' ',' ',' ',' ',' ',' ',' ',' ',' ',' ',' ',' ',' ',' ',' ',' ',' ',' ',' ',' ',' ',' ',' ',
' ',' ',' ',' ',' ',' ',' ',' ',' ',' ',' ',' ',' ',' ',' ',' ',' ',' ',' ',' ',' ',' ',' ',' ',' ',' ',' ','@',' ',' ',' ',' ',' ',' ',' ',' ',' ',' ',' ',' ',
' ',' ',' ',' ',' ',' ',' ',' ',' ',' ',' ',' ',' ',' ',' ',' ',' ',' ',' ',' ',' ',' ',' ',' ',' ','@',' ','@',' ',' ',' ',' ',' ',' ',' ',' ',' ',' ',' ',' ',
' ',' ',' ',' ',' ',' ',' ',' ',' ',' ',' ',' ',' ',' ',' ','@','@',' ',' ',' ',' ',' ',' ','@','@',' ',' ',' ',' ',' ',' ',' ',' ',' ',' ',' ',' ','@','@',' ',
' ',' ',' ',' ',' ',' ',' ',' ',' ',' ',' ',' ',' ',' ','@',' ',' ',' ','@',' ',' ',' ',' ','@','@',' ',' ',' ',' ',' ',' ',' ',' ',' ',' ',' ',' ','@','@',' ',
' ',' ',' ','@','@',' ',' ',' ',' ',' ',' ',' ',' ','@',' ',' ',' ',' ',' ','@',' ',' ',' ','@','@',' ',' ',' ',' ',' ',' ',' ',' ',' ',' ',' ',' ',' ',' ',' ',
' ',' ',' ','@','@',' ',' ',' ',' ',' ',' ',' ',' ','@',' ',' ',' ','@',' ','@','@',' ',' ',' ',' ','@',' ','@',' ',' ',' ',' ',' ',' ',' ',' ',' ',' ',' ',' ',
' ',' ',' ',' ',' ',' ',' ',' ',' ',' ',' ',' ',' ','@',' ',' ',' ',' ',' ','@',' ',' ',' ',' ',' ',' ',' ','@',' ',' ',' ',' ',' ',' ',' ',' ',' ',' ',' ',' ',
' ',' ',' ',' ',' ',' ',' ',' ',' ',' ',' ',' ',' ',' ','@',' ',' ',' ','@',' ',' ',' ',' ',' ',' ',' ',' ',' ',' ',' ',' ',' ',' ',' ',' ',' ',' ',' ',' ',' ',
' ',' ',' ',' ',' ',' ',' ',' ',' ',' ',' ',' ',' ',' ',' ','@','@',' ',' ',' ',' ',' ',' ',' ',' ',' ',' ',' ',' ',' ',' ',' ',' ',' ',' ',' ',' ',' ',' ',' ',
' ',' ',' ',' ',' ',' ',' ',' ',' ',' ',' ',' ',' ',' ',' ',' ',' ',' ',' ',' ',' ',' ',' ',' ',' ',' ',' ',' ',' ',' ',' ',' ',' ',' ',' ',' ',' ',' ',' ',' ',
' ',' ',' ',' ',' ',' ',' ',' ',' ',' ',' ',' ',' ',' ',' ',' ',' ',' ',' ',' ',' ',' ',' ',' ',' ',' ',' ',' ',' ',' ',' ',' ',' ',' ',' ',' ',' ',' ',' ',' ',
' ',' ',' ',' ',' ',' ',' ',' ',' ',' ',' ',' ',' ',' ',' ',' ',' ',' ',' ',' ',' ',' ',' ',' ',' ',' ',' ',' ',' ',' ',' ',' ',' ',' ',' ',' ',' ',' ',' ',' ',
' ',' ',' ',' ',' ',' ',' ',' ',' ',' ',' ',' ',' ',' ',' ',' ',' ',' ',' ',' ',' ',' ',' ',' ',' ',' ',' ',' ',' ',' ',' ',' ',' ',' ',' ',' ',' ',' ',' ',' ',
' ',' ',' ',' ',' ',' ',' ',' ',' ',' ',' ',' ',' ',' ',' ',' ',' ',' ',' ',' ',' ',' ',' ',' ',' ',' ',' ',' ',' ',' ',' ',' ',' ',' ',' ',' ',' ',' ',' ',' ',
' ',' ',' ',' ',' ',' ',' ',' ',' ',' ',' ',' ',' ',' ',' ',' ',' ',' ',' ',' ',' ',' ',' ',' ',' ',' ',' ',' ',' ',' ',' ',' ',' ',' ',' ',' ',' ',' ',' ',' ',
' ',' ',' ',' ',' ',' ',' ',' ',' ',' ',' ',' ',' ',' ',' ',' ',' ',' ',' ',' ',' ',' ',' ',' ',' ',' ',' ',' ',' ',' ',' ',' ',' ',' ',' ',' ',' ',' ',' ',' ',
' ',' ',' ',' ',' ',' ',' ',' ',' ',' ',' ',' ',' ',' ',' ',' ',' ',' ',' ',' ',' ',' ',' ',' ',' ',' ',' ',' ',' ',' ',' ',' ',' ',' ',' ',' ',' ',' ',' ',' '
};





char clear[] = {27, '[', '2', 'J', 0};

// Game buffers

void moveCursor(int row, int col) {
    printf("\033[%d;%dH", row + 1, col * 2 + 1);  // 1-based ANSI cursor
}

int main(void) {
    int i, j, n;

    printf(clear);  // clear the screen once at start

    // Copy current state to nextState
    for (i = 0; i < HEIGHT; i++)
        for (j = 0; j < WIDTH; j++)
            nextState[i][j] = currState[i][j];

    for (;;) {
        // === Bounding box of live cells ===
        int min_i = HEIGHT, max_i = 0, min_j = WIDTH, max_j = 0;
        for (i = 1; i < HEIGHT - 1; i++) {
            for (j = 1; j < WIDTH - 1; j++) {
                if (currState[i][j] == '@') {
                    if (i < min_i) min_i = i;
                    if (i > max_i) max_i = i;
                    if (j < min_j) min_j = j;
                    if (j > max_j) max_j = j;
                }
            }
        }

        // Nothing alive? Just skip to next frame
        if (min_i > max_i || min_j > max_j) {
            moveCursor(HEIGHT + 1, 0);
            puts("All cells dead. Press CTRL+C to quit.");
            continue;
        }

        // Expand bounding box safely
        if (min_i > 1) min_i--;
        if (max_i < HEIGHT - 2) max_i++;
        if (min_j > 1) min_j--;
        if (max_j < WIDTH - 2) max_j++;

        // === Game of Life Update ===
        for (i = min_i; i <= max_i; i++) {
            for (j = min_j; j <= max_j; j++) {
                n = 0;
                if (currState[i - 1][j - 1] == '@') n++;
                if (currState[i - 1][j    ] == '@') n++;
                if (currState[i - 1][j + 1] == '@') n++;
                if (currState[i    ][j - 1] == '@') n++;
                if (currState[i    ][j + 1] == '@') n++;
                if (currState[i + 1][j - 1] == '@') n++;
                if (currState[i + 1][j    ] == '@') n++;
                if (currState[i + 1][j + 1] == '@') n++;

                if (currState[i][j] == '@') {
                    nextState[i][j] = (n < 2 || n > 3) ? ' ' : '@';
                } else {
                    nextState[i][j] = (n == 3) ? '@' : ' ';
                }
            }
        }

        // === Only draw changed cells ===
        for (i = min_i; i <= max_i; i++) {
            int row_changed = 0;
            for (j = min_j; j <= max_j; j++) {
                if (currState[i][j] != nextState[i][j]) {
                    if (!row_changed) {
                        moveCursor(i, min_j);
                        row_changed = 1;
                    }
                    putchar(nextState[i][j] == '@' ? '@' : ' ');
                    putchar(' ');
                } else if (row_changed) {
                    // preserve spacing
                    putchar(' ');
                    putchar(' ');
                }
            }
        }

        // Copy nextState to currState
        for (i = min_i; i <= max_i; i++)
            for (j = min_j; j <= max_j; j++)
                currState[i][j] = nextState[i][j];

        // Move cursor below grid
        moveCursor(HEIGHT + 1, 0);
        puts("Press CTRL+C to quit.");
    }

    return 0;
}
