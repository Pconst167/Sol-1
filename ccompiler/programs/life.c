#include <stdio.h>
#include <stdlib.h>

#define WIDTH  40
#define HEIGHT 30

char clear[] = {27, '[', '2', 'J', 27, '[', 'H', 0};

// Global arrays to hold the current and next states of the game grid
char nextState[HEIGHT][WIDTH];
char currState[HEIGHT][WIDTH] = {
' ',' ',' ',' ',' ',' ',' ',' ',' ',' ',' ',' ',' ',' ',' ',' ',' ',' ',' ',' ',' ',' ',' ',' ',' ',' ',' ',' ',' ',' ',' ',' ',' ',' ',' ',' ',' ',' ',' ',' ',
' ',' ',' ',' ',' ',' ',' ',' ',' ',' ',' ',' ',' ',' ',' ',' ',' ',' ',' ',' ',' ',' ',' ',' ',' ',' ',' ',' ',' ',' ',' ',' ',' ',' ',' ',' ',' ',' ',' ',' ',
' ',' ',' ',' ',' ',' ',' ',' ',' ',' ',' ',' ',' ',' ',' ',' ',' ',' ',' ',' ',' ',' ',' ',' ',' ',' ',' ',' ',' ',' ',' ',' ',' ',' ',' ',' ',' ',' ',' ',' ',
' ',' ',' ',' ',' ',' ',' ',' ',' ',' ',' ',' ',' ',' ',' ',' ',' ',' ',' ',' ',' ',' ',' ',' ',' ',' ',' ','@',' ',' ',' ',' ',' ',' ',' ',' ',' ',' ',' ',' ',
' ',' ',' ',' ',' ',' ',' ',' ',' ',' ',' ',' ',' ',' ',' ',' ',' ',' ',' ',' ',' ',' ',' ',' ',' ','@',' ','@',' ',' ',' ',' ',' ',' ',' ',' ',' ',' ',' ',' ',
' ',' ',' ',' ',' ',' ',' ',' ',' ',' ',' ',' ',' ',' ',' ','@','@',' ',' ',' ',' ',' ',' ','@','@',' ',' ',' ',' ',' ',' ',' ',' ',' ',' ',' ',' ','@','@',' ',
' ',' ',' ',' ',' ',' ',' ',' ',' ',' ',' ',' ',' ',' ','@',' ',' ',' ','@',' ',' ',' ',' ','@','@',' ',' ',' ',' ',' ',' ',' ',' ',' ',' ',' ',' ','@','@',' ',
' ',' ',' ','@','@',' ',' ',' ',' ',' ',' ',' ',' ','@',' ',' ',' ',' ',' ','@',' ',' ',' ','@','@',' ',' ',' ',' ',' ',' ',' ',' ',' ',' ',' ',' ',' ',' ',' ',
' ',' ',' ','@','@',' ',' ',' ',' ',' ',' ',' ',' ','@',' ',' ',' ','@',' ','@','@',' ',' ',' ',' ','@',' ','@',' ',' ',' ',' ',' ',' ',' ',' ',' ',' ',' ',' ',
' ',' ',' ',' ',' ',' ',' ',' ',' ',' ',' ',' ',' ','@',' ',' ',' ',' ',' ','@',' ',' ',' ',' ',' ',' ',' ','@',' ',' ',' ',' ',' ',' ',' ',' ',' ',' ',' ',' ',
' ',' ',' ',' ',' ',' ',' ',' ',' ',' ',' ',' ',' ',' ','@',' ',' ',' ','@',' ',' ',' ',' ',' ',' ',' ',' ',' ',' ',' ',' ',' ',' ',' ',' ',' ',' ',' ',' ',' ',
' ',' ',' ',' ',' ',' ',' ',' ',' ',' ',' ',' ',' ',' ',' ','@','@',' ',' ',' ',' ',' ',' ',' ',' ',' ',' ',' ',' ',' ',' ',' ',' ',' ',' ',' ',' ',' ',' ',' ',
' ',' ',' ',' ',' ',' ',' ',' ',' ',' ',' ',' ',' ',' ',' ',' ',' ',' ',' ',' ',' ',' ',' ',' ',' ',' ',' ',' ',' ',' ',' ',' ',' ',' ',' ',' ',' ',' ',' ',' ',
' ',' ',' ',' ',' ',' ',' ',' ',' ',' ',' ',' ',' ',' ',' ',' ',' ',' ',' ',' ',' ',' ',' ',' ',' ',' ',' ',' ',' ',' ',' ',' ',' ',' ',' ',' ',' ',' ',' ',' ',
' ',' ',' ',' ',' ',' ',' ',' ',' ',' ',' ',' ',' ',' ',' ',' ',' ',' ',' ',' ',' ',' ',' ',' ',' ',' ',' ',' ',' ',' ',' ',' ',' ',' ',' ',' ',' ',' ',' ',' ',
' ',' ',' ',' ',' ',' ',' ',' ',' ',' ',' ',' ',' ',' ',' ',' ',' ',' ',' ',' ',' ',' ',' ',' ',' ',' ',' ',' ',' ',' ',' ',' ',' ',' ',' ',' ',' ',' ',' ',' ',
' ',' ',' ',' ',' ',' ',' ',' ',' ',' ',' ',' ',' ',' ',' ',' ',' ',' ',' ',' ',' ',' ',' ',' ',' ',' ',' ',' ',' ',' ',' ',' ',' ',' ',' ',' ',' ',' ',' ',' ',
' ',' ',' ',' ',' ',' ',' ',' ',' ',' ',' ',' ',' ',' ',' ',' ',' ',' ',' ',' ',' ',' ',' ',' ',' ',' ',' ',' ',' ',' ',' ',' ',' ',' ',' ',' ',' ',' ',' ',' ',
' ',' ',' ',' ',' ',' ',' ',' ',' ',' ',' ',' ',' ',' ',' ',' ',' ',' ',' ',' ',' ',' ',' ',' ',' ',' ',' ',' ',' ',' ',' ',' ',' ',' ',' ',' ',' ',' ',' ',' ',
' ',' ',' ',' ',' ',' ',' ',' ',' ',' ',' ',' ',' ',' ',' ',' ',' ',' ',' ',' ',' ',' ',' ',' ',' ',' ',' ',' ',' ',' ',' ',' ',' ',' ',' ',' ',' ',' ',' ',' '
};

int main(void){
	int i, j;
  int n;
	char *p = 0;
/*
	for(i = 0; i < HEIGHT; i++){
		for(j = 0; j < WIDTH; j++){
			if(*p % 2 == 0) currState[i][j] = '@';
			else currState[i][j] = ' ';
			p++;		
		}
	}
*/
	for(i = 0; i < HEIGHT; i++){
		for(j = 0; j < WIDTH; j++){
			nextState[i][j] = currState[i][j];
		}
	}

	for(;;){
		for(i = 1; i < HEIGHT+-1; i++){
			for(j = 1; j < WIDTH+-1; j++){
				n = 0;
				if(currState[i+-1][j] == '@')			n++;
				if(currState[i+-1][j+-1] == '@') 	n++;
				if(currState[i+-1][j+1] == '@') 	n++;
				if(currState[i][j+-1] == '@') 		n++;
				if(currState[i][j+1] == '@') 			n++;
				if(currState[i+1][j+-1] == '@') 	n++;
				if(currState[i+1][j] == '@') 			n++;
				if(currState[i+1][j+1] == '@') 		n++;
				if(n < 2 || n > 3) nextState[i][j] = ' ';
	      else if(n == 3) nextState[i][j] = '@';
			}
    }
		for(i = 1; i < HEIGHT+-1; i++){
			for(j = 1; j < WIDTH+-1; j++){
				currState[i][j] = nextState[i][j];
			}
    }
		printf(clear);
		for(i = 0; i < HEIGHT; i++){
			for(j = 0; j < WIDTH; j++){
				currState[i][j] == '@' ? printf("@ ") : printf(". ");
			}
			printf("\n\r");
		}
		puts("\n\rPress CTRL+C to quit.\n\r");
	}
}