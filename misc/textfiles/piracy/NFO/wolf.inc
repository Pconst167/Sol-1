
          INC '91 CLASSICS Department Proudly Presents:
                    Beyond Castle Wolfenstein
                    Written By: MUSE Software
                      Supplied By: Phantom
                  Packaged/Cracked By: Phantom


     Alright folx, you don't have to tell me - I already know.
You have been waiting years for this INC release! But seriously
here is the scoop on Beyond Castle Wolfenstein:
 
     Around 1983, MUSE Software created an ALLTIME cult classic
by the name of 'Castle Wolfenstein'. Those of you diehard
Apple/Commodore/PCjr fans could never forget this game. Even some
of you who weren't around back then probably remember this game
from a friend or aquaintance. The simple goal was to infiltrate
Hitler's bunker, kill some people, and rescue the plans!

     In 1985, MUSE released another smash game - the sequel to
Castle Wolfenstein called Beyond Castle Wolfenstein! This game
had quicker action and even sported amazing CGA! (A breakthrough
at this time). Instead of rescuing "plans", now you searched the
castle for a bomb to plant in Hitler's bunker (you even get to
see a very detailed Hitler marching around yelling "Heil!"). You
can pick up daggers to stab people quietly, first aid kits to aid
yourself if shot, and tool boxes to disarm the alarms that the
German guards can set up! This game was and probably still is my
all-time favorite strategy game. It is funny, fun, and back to
the simple basics which used to make a game a classic. I suggest
you take some time, un-teledisk this bitch and throw it on a
disk. It will be worth it to some of you oldies, and even some of
you young'ens out there in pirate land!

    INSTALLATION:

       This is not VERY difficult, but it can be a pain in the
ass. Find yourself a 360k disk (Doesn't have to be formatted).
Stick it in drive A: or B: and unteledisk the file BCW.TD0 onto
the floppy. It doesn't take long. Then, turn turbo off on your
computer, stick the floppy on your bootup drive, and cold boot
your system. If you did it correctly, the CGA title screen should
show up.

     GAME PLAY:

        Keep in mind we are dealing with a cerca 1985 game here!

 
         Q  W  E                 I  O  P
          A  S  D                 K  L  ;
           Z  X  C                 ,  .  /

           ^                        ^
           |                        |
 
        These keys control        These Keys Control Aiming the
     moving the guy around.       gun. L fires the gun. H hols-
     S Stops the guy.             ters the gun!

     The passes you see on the left are the passes you start out
with. When a guard yells at you, you are best advised to go over
to him, and stop. Then he will ask for your pass, offer him one
that you have by typing in the various pass numbers. If you get
the right one, then he will yell, "Heil!", and you can go on.


     This game is fairly intricate so I shall spare you all of
the details, and allow you to discover them for yourself. This is
a very cool classic, and I hope some of you will enjoy returning
to your past!

     
            Happy Killing!

   oh BTW: Hitler's Bunker is on the THIRD floor, be sure to
RESET your bomb once you find it - else it will explode in your
hands, a very dirty site..

   another BTW: If all you have is a 386 - 25, I seriously doubt
this game will run on your system. You are welcome to try it out
though!


                - Phantom
                  SysOp of XTC Systems
