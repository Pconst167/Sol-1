
                            ***  INC Presents  ***

                            Wayne Gretzky Hockey II
                                      by
                            Bethesda Systems, Inc.

                    Cracked by Null Set and Bit-Manipulator


Greetings again, kind friends.  Null Set here.  This game had some fair
protection on it.  The hardest part was getting past the damn encryption
(which is what takes the game so long to load - it is decrypting itself
a zillion times over in memory).  Bit-Manipulator figured out the basic
crack for the game, with only sporadic help from me.  I then tagged in and
figured out how to patch the game and then wrote the patch, with help from
Bit-Manipulator.  All in all, a good 6 hours work.

Oh, yea, the command line params we have figured out so far seem to be;

                -c      CGA mode
                -e      EGA mode
                -t      Tandy mode

The order of the parameters doesn't seem to matter, but the Hockey.Bat file
seems to suggest a maximum of three parameters, one video, one sound, and
one I don't know what!  Anyone with the docs, please wang out the loading
info, eh?

The supports a mouse, but also has some good keyboard handling.  I think it's
biggest flaw is the actual game play itself.  It doesn't measure up to
FaceOff standards!

Well, that's all for now folks... We'll see you in our next adventure!
(Coming soon to a board near you).

-Null Set and Bit-Manipulator

