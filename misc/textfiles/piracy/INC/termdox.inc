                           Typed by Line Noise
                    The Terminator IBM Reference Card
                    =================================

General Keyboard Commands
-------------------------

 ESC                              Game Menu / Pause
 F10                              Player Menu / Pause
 P                                Phone Book
 F9                               Information View
 SHIFT+F9                         Full Screen View
 ALT-M                            Full Area Map / Fast Travel / Homing Device
 M                                Local Area Map / Fast Travel / Homing Device
 F1-F8                            Select Weapon / Reload Weapon
 ALT F1-F8                        Force Reload
 CTRL F1-F8                       Deselect Weapon
 ENTER                            Fire Weapon
 TAB                              Fire Weapon
 SPACE BAR + ARROW KEYS           Aim Weapon Sights
 \                                Crosshair Centering
 - [MINUS]                        Systems Status Strobe On/Off [Terminator]
 = [EQUALS]                       Heads Up Display On/Off [Terminator]
 SHIFT =                          Large Crosshairs On/Off [Terminator]
 Z                                Zoom Lens On/Off [Terminator]
 X                                Target Lock Toggle
 ALT 1-3                          Graphics Detail Level


Map Level Keyboard Commands
---------------------------

F                                 Fast Travel
H                                 Homing Display


Walking Mode General Keyboard Commands
--------------------------------------

L                                 Look at Object
E                                 Enter Car
B                                 Binoculars
S                                 Enter Store


Walking Mode Movement Keyboard Commands
---------------------------------------

Up Arrow                          Walk Forward
Down Arrow                        Walk Backward
Right Arrow                       Turn Right
Left Arrow                        Turn Left
Alt + Right Arrow                 Move Sideways + Right
Alt + Left Arrow                  Move Sideways + Left
Delete                            Very fast left turn
Page Down                         Very fast right turn
1 thru 0                          Walking Speed


Driving Mode Keyboard Commands
------------------------------

S                                 Start Car
Up Arrow                          Accelerate
Down Arrow                        Decelerate
Right Arrow                       Turn Right
Left Arrow                        Turn Left
] Right Bracket                   Brake
W                                 Walking Mode


Automatic Transmission Keyboard Commands
----------------------------------------

Insert                            Reverse
Delete                            Park
Home                              Drive
End                               2nd Gear
Page Up                           Neutral
Page Down                         1st Gear


Stick Shift Keyboard Commands
-----------------------------

Backspace                         Clutch
Insert                            1st Gear
Delete                            2nd Gear
Home                              3rd Gear
End                               4th Gear
Page Up                           Neutral
Page Down                         Reverse


General Vision Keyboard Commands
--------------------------------

Ctrl + Up Arrow                   Look Forward
Ctrl + Down Arrow                 Look Behind
Ctrl + Right Arrow                Look Right
Ctrl + Left Arrow                 Look Left


Ratings Screen Keyboard Commands
--------------------------------

1 thru 5                          Top 5 Game Stats
Spacebar                          Your Rating
N                                 Name Change


Damage Screen Keyboard Commands
-------------------------------

H                                 Heal Head
T                                 Heal Torso
A                                 Heal Arms
L                                 Heal Legs
