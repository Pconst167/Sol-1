                   INC/PE- Presents SPACE ACE
                    Supplied By: Trade Mark
                     Cracked By: Jake Pickett
                     

This game was co released by PE yes thats right an INC/PE release.

Well I am really enjoying this, well I allways enjoy it when The Humble Guy's
open thier big mouths and insert thier feet. As you all know they got the 
first disk to this game off a BBS in Canada and then claimed they were 
releasing it hahaha.  They did not have the whole game as you all have pro-
baly figured out.  Slave Lord you are such and idiot maybe Line Noise aught
to lend you his tissue. Candyman you are a lying lame dumbfuck why don't you
go back to masterbation and leave the pirateing sceen to a real group like
INC.  

                               Cool Hand

I hope all of you (the public) now relize THG's true colors.  You must agree
that it was lame for them to put out Disk 1 of a game that they did dont have
in the first place.  We hope you relize that THG has been lying to us and all
of you and we think that they should pay.  Candyman and Slavelord I allways
believed that one of these days your lying would get you into trouble.

                                Line Noise


Speacial Thanks to Jenecide, Lazarus Long and Blade Runner...


                           Cool Hand


Call:   Ninja Uniform       C.O.P.S.              V.O.I.D.
        (416)841-8497       (416)PRI-VATE         (416)Comming-Soon
        Sysop: Trade Mark   Sysop: Lazarus Long   Sysop: Jenecide
        NUP: Joker          PE SITE/2 NODES       INC SITE