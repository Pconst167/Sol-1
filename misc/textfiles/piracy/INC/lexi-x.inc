Lexi-Cross                                  Cracked by Jake Pickett
   by                                       Supplied by The Jet
    Interplay

Object: The audience cheers! Lights flood the stage! The tension mouts!
 The read "On the Air" light goes on and... it's time to play
 Lexi-Cross, the galaxy's favorite 21st century game show. Step into the
 future of television game shows and play the most addictive, though-provoking
 word game on the planet. You'll put your memory, strategic, and
 puzzle-solving skills to the supreme test in this fast-paced,
 futuristic game show that's sweeping the universe. Spin for letters,
 buy vowels, uncover words, ask for clues and watch as the beautiful
 Robanna turns over world tiles in more than 600 brain-teasing puzzles
 challenging enough to make even the most diehard couch potato forget
 completely about that remote control.

Jake's Notes: Well this one had 3 levels of unencryption in it and as a result
it was none to easy to crack.  The fix works fine for the game with just one
minor side effect.  While all the graphic modes and all other options work
fine, there is no way to shut off the sound. Sorry for the inconvenience but
it is really a minor annoyance at best. This fix takes care of the first doc
check and as far as I can tell this is the only check in the game. Of course,
if you find another doc check please contact you local INC rep and report the
problem to them. I will then take steps to correct the problem.
For the record I owe a debt of thanks to Billy Name for allowing me to use his
TSR source code since I did not have the time to write one from scratch since
this was one hell of a program to crack.
 
