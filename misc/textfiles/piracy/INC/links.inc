                        Links by Access Software

                      Released by INC: on 11/05/90
                      Supplied by    : Captain Crunch

Game Info:
             Here's the hottest game out since Space Ace. This game is
  just simply amazing. The graphics, and sound are wonderful. Hope it
  isnt overshadowed by Space Ace, which by now all of the US (or most of
  it anyways) should have INC/PE's copy. Curious to see the aftermath of
  our message. I have seen some posts so far and the results are
  excellent. The world is finally realizing that THG has been lieing
  since they existed, and we proved it to them.

             By the way, something to think about. Notice THG put the
  rest of Space Ace out after INC/PE did. Seems to me that they took
  ours and renamed it. Of course there is never any way to prove it, so
  use your judgement. Just keep in mind that if they did put the rest
  out, that it was AFTER we did, which means we actually put the whole
  thing out before them anyways. Doesn't matter, I've called numerous
  boards, of all cracking groups, and our Space Ace is everywhere. Hope
  THG learns there lesson this time.

              Anyhow, back to this game. You need to install the game from
  floppy, no avoiding it. And you need all the disks the install it, or it
  won't work. Enjoy the game, from INC of course!

                -Line Noise




    Well, here we are at the beginning of November. We know from Claude Rains
list of up and coming releases that there are quite a few new releases on
their way. In fact, in the next few months, the major software companies will
be putting out 100's of games. This is kind of a mixed blessing from us here
at INC. We will have to work our asses off to provide you with the newest and
most quality American games, yet at the same time, we are truly ecstatic,
that you, our supporter, will get to enjoy the cream of the crop software.
We are coming through on our part of the committment, that is, the releases
keep coming, right and left. The majority of the "QUALITY" AMERICAN releases
originate from INC. So no matter what THG says, INC will continue to prove
to you that WE ARE THE BEST. All of the negative filth that THG has spewed
out, ranging from their insistance on Humble "Slaves", their filthy treat-
ment of members, and the general Public, YOU, has generated the most negative
image that is now crippling THG severely. A cracking group based on hate,
will soon fall simply because that's all it CAN do - is hate.

    Sure, all of this is based upon The Slavelord, and as such, Candyman. But
don't think that they don't just love this publicity. They eat it up.

    Enough of the bitching, go ahead and enjoy this excellent INC game -
LINKS, released by ACCESS. This is a SUPERB game, and as always -
thankyou for supporting the cracking group who not only cares about IT'S
image, it cares about you, the user of our quality cracks.






Greets out to Cool Hand - Your persistance has paid off, the BIGGEST release
of the year, Space Ace, has been put out thanks to mutual efforts by INC and
PE. For this, INC personally thanks Cool Hand for his efforts.

Reaper - Treta loves you more than me now..boohoo
Jenecide - Welcome to the crew!
Humble Slave #10 - Congrats for changing over to INC, maybe now you can
restore your pride.
Treta - Forget Reaper...He isn't worth it..
Smudude - Welcome back!
Line Noise - Has Ken recieved his box of tissues yet? He'll need 'em.

And to the rest of our adoring public, Thanx for choosing INC '90!!!!

                    Phantom 11-5-90


     Call                  Call                Call
     X-T-C Systems         Midnite Oil         Elm Street
     (214)348-1022         (214)298-4102       (214)407-1801


