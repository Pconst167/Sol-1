

                        INC 1990 Presents
                     Joe Montana's Football
                    Supplied by: Jake Pickett
                Cracked by: R. Bubba Magillicutty
                      Packaged by: Phantom

VIDEO SUPPORTS:/EGA/VGA
SOUND CARDS:/SOUNDBLASTER/ADLIB


      Well here is Joe Montana's Football brought to you by INC.
This game looks VERY NICE. I personally prefer baseball sims, but
here is a nice football sim for those who like them. Some nice
digitized graphics and Soundblaster support for those with VGA...

      Special Thanks to R. Bubba Magillicutty for his time and
effort with this one. It was a bitch to crack, but hey, what
CAN'T R. Bubba crack?

      Other Greets out to Gopher, the never-ending non-official
courier. Norman Bates -= I don't imagine you will ever read this,
but if you ever do get an HST...haha. Freddy Krueger -= we'll see
that damn movie yet. Shadow Demon -= How is the Image refurbing
going? Pieman, Surak -= fucking trojans! Dark Knight -= Keep up
the great work!

      Well that's about it. If you are interested in picking up
an HST for 529$ or a Dual for 749$ contact some dude named Robert
at (214) 348-6000...

  Call Midnite Oil         &              X-T-C Systems
     (214)298-4102                        (214)Fuck-Off




                                      --Phantom
