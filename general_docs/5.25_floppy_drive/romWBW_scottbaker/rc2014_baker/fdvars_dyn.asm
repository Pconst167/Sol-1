;==================================================================================================
;   FLOPPY DISK DRIVER - DATA
;==================================================================================================

FDSTART         .EQU     $C000

DIOBUF          .EQU     FDSTART
HSTDSK          .EQU     DIOBUF+2
HSTTRK          .EQU     HSTDSK+1
HSTSEC          .EQU     HSTTRK+2

FCP_CMD		.EQU     HSTSEC+2
FCP_LEN		.EQU     FCP_CMD+1
FCP_BUF         .EQU     FCP_LEN+1
FCP_CMDX	.EQU     FCP_BUF
FCP_HDSDS	.EQU	FCP_CMDX+1
FCP_C		.EQU	FCP_HDSDS+1
FCP_H		.EQU	FCP_C+1
FCP_R		.EQU	FCP_H+1
FCP_N		.EQU	FCP_R+1
FCP_EOT		.EQU	FCP_N+1
FCP_GPL		.EQU	FCP_EOT+1
FCP_DTL		.EQU	FCP_GPL+1
FCP_BUFSIZ	.EQU	FCP_DTL-FCP_BUF+1
;
; FDC STATUS
;
FST_RC		.EQU	FCP_DTL+1
FST_DOR		.EQU	FST_RC+1
FST_DCR		.EQU	FST_DOR+1
;
; FDC RESULTS BUFFER
;
FRB_LEN		.EQU	FST_DCR+1
FRB             .EQU    FRB_LEN+1
FRB_ST0         .EQU    FRB
FRB_ST3		.EQU    FRB
FRB_ST1         .EQU    FRB_ST3+1
FRB_PCN		.EQU    FRB_ST1
FRB_ST2		.EQU	FRB_PCN+1
FRB_C		.EQU	FRB_ST2+1
FRB_H		.EQU	FRB_C+1
FRB_R		.EQU	FRB_H+1
FRB_N		.EQU	FRB_R+1
FRB_SIZ		.EQU	FRB_N-FRB+1
;
; FDC COMMAND DATA
;
		; FLOPPY CONFIGURATION DATA (PUBLIC) MANAGED AS A "BLOCK"
FCD             .EQU    FRB_N+1
FCD_NUMCYL	.EQU	FCD		; NUMBER OF CYLINDERS
FCD_NUMHD	.EQU	FCD_NUMCYL+1		; NUMBER OF HEADS
FCD_NUMSEC	.EQU	FCD_NUMHD+1		; NUMBER OF SECTORS
FCD_SOT		.EQU	FCD_NUMSEC+1		; START OF TRACK (ID OF FIRST SECTOR, USUALLY 1)
FCD_EOT		.EQU    FCD_SOT+1			; END OF TRACK SECTOR (SAME AS SC SINCE SOT ALWAYS 1)
FCD_SC		.EQU	FCD_EOT		; SECTOR COUNT
FCD_SECSZ	.EQU	FCD_SC+1		; SECTOR SIZE IN BYTES
FCD_GPL		.EQU	FCD_SECSZ+2		; GAP LENGTH (R/W)
FCD_GPLF	.EQU	FCD_GPL+1		; GAP LENGTH (FORMAT)
FCD_SRTHUT	.EQU	FCD_GPLF+1		; STEP RATE, IBM PS/2 CALLS FOR 3ms, 0DH = 3ms SRT, HEAD UNLOAD TIME
FCD_HLTND	.EQU	FCD_SRTHUT+1		; HEAD LOAD TIME, IBM PS/2 CALLS FOR 15ms 08H = 16ms HUT
FCD_DOR		.EQU	FCD_HLTND+1		; DOR VALUE
FCD_DCR		.EQU	FCD_DOR+1		; DCR VALUE
;FCD_LEN		.EQU	FCD_DOR - FCD + 1
		; DYNAMICALLY MANAGED (PUBLIC)
FCD_DS		.EQU	FCD_DCR+1		; DRIVE SELECT (UNIT NUMBER 0-3)
FCD_C		.EQU	FCD_DS+1		; CYLINDER
FCD_H		.EQU	FCD_C+1		; HEAD
FCD_R		.EQU	FCD_H+1		; RECORD
FCD_D		.EQU	FCD_R+1		; DATA FILL BYTE
		; STATUS MANAGEMENT
FCD_DOP		.EQU	FCD_D+1		; CURRENT OPERATION (SEE DOP_...)
FCD_IDLECNT	.EQU	FCD_DOP+1		; IDLE COUNT
FCD_TRACE	.EQU	FCD_IDLECNT+2		; TRACE LEVEL
FCD_TO		.EQU	FCD_TRACE+1		; TIMEOUT COUNTDOWN TIMER
FCD_FDCRDY	.EQU	FCD_TO+1		; FALSE MEANS FDC RESET NEEDED
;
; FLOPPY UNIT DATA
;
FCD_UNITS:      .EQU    FCD_FDCRDY+1
FCD_U0TRK	.EQU	FCD_UNITS		; CURRENT TRACK
FCD_U0MEDIA	.EQU	FCD_U0TRK+1		; MEDIA BYTE
FCD_U1TRK	.EQU	FCD_U0MEDIA+1		; CURRENT TRACK
FCD_U1MEDIA	.EQU	FCD_U1TRK+1		; MEDIA BYTE
;
; WORKING STORAGE (DERIVED FROM ABOVE FOR ACTIVE DRIVE UNIT)
;
FDDS_TRKADR	.EQU	FCD_U1MEDIA+1	; POINTER TO FDCUXTRK ABOVE
FDDS_MEDIAADR	.EQU	FDDS_TRKADR+2	; POINTER TO FDCUXMEDIA ABOVE

FD_DATA_LEN     .EQU    FDDS_MEDIAADR - FDSTART + 2

; initialize things that would have been preinitialized
FD_INITVARS:     LD     HL, FDSTART
                 LD     B, FD_DATA_LEN
                 LD     A,0
zeroit:          LD     (HL), A
                 INC    HL
                 djnz   zeroit

                 LD     A, $FF
                 LD     (FCD_U0TRK), A
                 LD     (FCD_U1TRK), A
                 LD     (FCD_DOP), A

                 LD     A,1
                 LD     (FCD_DS), A
                 LD     (FCD_R), A

                 LD     A, $E5
                 LD     (FCD_D), A

                 RET

